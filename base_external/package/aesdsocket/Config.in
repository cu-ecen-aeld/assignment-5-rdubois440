## base_external/package/aesdsocket/Config.in
```kconfig
config BR2_PACKAGE_AESDSOCKET
	bool "aesdsocket"
	help
	  Simple socket server
	  Used to understand buildroot external trees and package builds.
```
